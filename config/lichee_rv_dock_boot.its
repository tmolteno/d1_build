## config/lichee_rv_dock_boot.its
```
/dts-v1/;

/ {
    description = "Lichee RV FIT Image";

    images {
        uboot {
            description = "U-Boot";
            data = /incbin/("u-boot/u-boot-nodtb.bin");
            type = "standalone";
            os = "U-Boot";
            arch = "riscv";
            compression = "none";
            load = <0x4a000000>;
        };
        opensbi {
            description = "RISC-V OpenSBI";
            data = /incbin/("fw_dynamic.bin");
            type = "firmware";
            os = "opensbi";
            arch = "riscv";
            compression = "none";
            load = <0x40000000>;
            entry = <0x40000000>;
        };
        fdt-1 {
            description = "DTB";
            data = /incbin/("u-boot/arch/riscv/dts/sun20i-d1-lichee-rv-dock.dtb");
            type = "flat_dt";
            arch = "riscv";
            compression = "none";
            load = <0x44000000>;
            entry = <0x44000000>;
        };
        fdt-2 {
            description = "Mini-LCD";
            data = /incbin/("u-boot/arch/riscv/dts/ov_lichee_rv_mini_lcd.dtb");
            type = "flat_dt";
            arch = "riscv";
            load = <0x44000000>;
        };
    };

    configurations {
        default = "standard.dtb";
        standard.dtb {
            description = "Standard Boot";
            firmware = "opensbi";
            loadables = "uboot";
            fdt = "fdt-1";
        };
        mini-lcd.dtb {
            description = "Standard with Mini LCD";
            firmware = "opensbi";
            loadables = "uboot";
            fdt = "fdt-1", "fdt-2";
        };
    };
};
```
